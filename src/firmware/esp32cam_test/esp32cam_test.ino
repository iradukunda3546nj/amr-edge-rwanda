/**
 * AMR-Edge: ESP32-CAM bench test (Arduino IDE, AI-Thinker ESP32-CAM).
 *
 * 1. Boot self-test: runs the INT8 model on the 64 golden vectors and checks the
 *    logits bit-exact against TensorFlow Lite, checks preprocessing against the
 *    Python training transform, and measures latency on this chip.
 * 2. Live test: serves a page where you box the meter's digit window on a camera
 *    frame. The board splits the box into wheels, centres a training-geometry
 *    crop on each digit, normalises and classifies it, and reports the reading
 *    with per-stage timings.
 *
 * Board: "AI Thinker ESP32-CAM" (esp32 core 3.x), PSRAM enabled.
 * Model and vectors: digit_model_int8.h and golden_vectors.h, generated by
 * tools/gen-esp32cam.cjs. The production firmware (ESP32-S3, ESP-IDF, ESP-NN,
 * LTE modem) is src/firmware/esp32_edge_ocr.cpp; this sketch only tests the model.
 */
#include <Preferences.h>
#include <WebServer.h>
#include <WiFi.h>

#include "esp_camera.h"
#include "esp_timer.h"
#include "img_converters.h"

#include "amr_model.h"
#include "digit_model_int8.h"
#include "golden_vectors.h"

// ============================================================================
// Configuration
// ============================================================================
static const char *WIFI_SSID = "CANALBOX-994A-2G";             // your router; leave empty to use the board's own access point
static const char *WIFI_PASS = "Home@2025";
static const char *AP_SSID = "AMR-ESP32CAM";   // access point fallback: join it, then open http://192.168.4.1
static const char *AP_PASS = "amredge123";
static const int FLASH_LED = 4;                // on-board white LED
static const int MAX_CROP_W = 16 * DIGIT_IN_W; // preprocessing area-filter limits
static const int MAX_CROP_H = 256;

// Training-crop geometry (src/web/js/core/counter-locator.js): 80x100 px crops,
// glyph ~62% of the crop height.
static const float ROI_HEIGHT_PER_GLYPH = 1.6f;
static const float ROI_ASPECT = 0.8f;
static const int SEARCH_MAX_PX = 160000;       // glyph search window, per wheel

// AI-Thinker ESP32-CAM camera pins
#define PWDN_GPIO_NUM 32
#define RESET_GPIO_NUM -1
#define XCLK_GPIO_NUM 0
#define SIOD_GPIO_NUM 26
#define SIOC_GPIO_NUM 27
#define Y9_GPIO_NUM 35
#define Y8_GPIO_NUM 34
#define Y7_GPIO_NUM 39
#define Y6_GPIO_NUM 36
#define Y5_GPIO_NUM 21
#define Y4_GPIO_NUM 19
#define Y3_GPIO_NUM 18
#define Y2_GPIO_NUM 5
#define VSYNC_GPIO_NUM 25
#define HREF_GPIO_NUM 23
#define PCLK_GPIO_NUM 22

// ============================================================================
// State
// ============================================================================
static WebServer server(80);
static Preferences prefs;

struct SelfTest {
    int exact, mismatched_bytes, label_hits;  // golden vectors
    int pre_exact, pre_max_diff;              // preprocessing cases
    float infer_us, pre_us;                   // mean per wheel
};
static SelfTest g_test;

static uint8_t *g_frame = nullptr;  // last captured grayscale frame (PSRAM)
static int g_fw = 0, g_fh = 0;
static float g_capture_ms = 0;
static bool g_hmirror = false, g_vflip = false;

static uint8_t *g_crop = nullptr;   // one wheel crop, preprocessing input
static uint8_t *g_search = nullptr; // glyph search window
static uint8_t *g_seen = nullptr;   // flood-fill visited flags
static int32_t *g_stack = nullptr;  // flood-fill stack

struct Box {
    int x, y, w, h;
};

static inline int64_t now_us() { return esp_timer_get_time(); }
static char class_char(int cls) { return cls < 10 ? char('0' + cls) : 'X'; }

// ============================================================================
// Self-test
// ============================================================================
static void run_selftest() {
    SelfTest t = {};
    int8_t logits[DIGIT_NUM_CLASSES];
    for (int i = 0; i < GOLDEN_N; ++i) {
        amr_invoke(GOLDEN_INPUTS[i], logits);
        int diff = 0, best = 0;
        for (int k = 0; k < DIGIT_NUM_CLASSES; ++k) {
            diff += logits[k] != GOLDEN_LOGITS[i][k];
            if (logits[k] > logits[best]) best = k;
        }
        t.exact += diff == 0;
        t.mismatched_bytes += diff;
        t.label_hits += best == GOLDEN_LABELS[i];
    }

    const int reps = 3;
    int64_t t0 = now_us();
    for (int r = 0; r < reps; ++r)
        for (int i = 0; i < GOLDEN_N; ++i) amr_invoke(GOLDEN_INPUTS[i], logits);
    t.infer_us = float(now_us() - t0) / (reps * GOLDEN_N);

    int8_t out[DIGIT_IN_W * DIGIT_IN_H];
    int64_t pre_total = 0;
    for (int i = 0; i < PRE_N; ++i) {
        t0 = now_us();
        amr_normalize(PRE_SRC[i], PRE_W, PRE_H, out);
        pre_total += now_us() - t0;
        int max_diff = 0;
        for (int k = 0; k < DIGIT_IN_W * DIGIT_IN_H; ++k) {
            const int d = abs(int(out[k]) - DIGIT_IN_ZERO_POINT - int(PRE_EXPECTED[i][k]));
            if (d > max_diff) max_diff = d;
        }
        t.pre_exact += max_diff == 0;
        if (max_diff > t.pre_max_diff) t.pre_max_diff = max_diff;
    }
    t.pre_us = float(pre_total) / PRE_N;
    g_test = t;

    Serial.println();
    Serial.println("=== AMR-Edge INT8 self-test ===");
    Serial.printf("CPU %u MHz, %u MACs per wheel\n", getCpuFrequencyMhz(), amr_macs());
    Serial.printf("Kernels: %d/%d golden vectors bit-exact vs TFLite (%d mismatched logits)\n", t.exact, GOLDEN_N, t.mismatched_bytes);
    Serial.printf("Top-1 agrees with label: %d/%d\n", t.label_hits, GOLDEN_N);
    Serial.printf("Preprocessing: %d/%d cases identical to Python (max diff %d)\n", t.pre_exact, PRE_N, t.pre_max_diff);
    Serial.printf("Latency per wheel: inference %.0f us, preprocessing %.0f us\n", t.infer_us, t.pre_us);
    Serial.printf("Throughput: %.1f MMAC/s\n", amr_macs() / t.infer_us);
    Serial.println(t.exact == GOLDEN_N && t.pre_exact == PRE_N ? "RESULT: PASS" : "RESULT: FAIL");
}

// ============================================================================
// Camera
// ============================================================================
static void apply_orientation() {
    if (sensor_t *s = esp_camera_sensor_get()) {
        s->set_hmirror(s, g_hmirror);
        s->set_vflip(s, g_vflip);
    }
}

static bool camera_init() {
    camera_config_t c = {};
    c.pin_pwdn = PWDN_GPIO_NUM;
    c.pin_reset = RESET_GPIO_NUM;
    c.pin_xclk = XCLK_GPIO_NUM;
    c.pin_sccb_sda = SIOD_GPIO_NUM;
    c.pin_sccb_scl = SIOC_GPIO_NUM;
    c.pin_d7 = Y9_GPIO_NUM;
    c.pin_d6 = Y8_GPIO_NUM;
    c.pin_d5 = Y7_GPIO_NUM;
    c.pin_d4 = Y6_GPIO_NUM;
    c.pin_d3 = Y5_GPIO_NUM;
    c.pin_d2 = Y4_GPIO_NUM;
    c.pin_d1 = Y3_GPIO_NUM;
    c.pin_d0 = Y2_GPIO_NUM;
    c.pin_vsync = VSYNC_GPIO_NUM;
    c.pin_href = HREF_GPIO_NUM;
    c.pin_pclk = PCLK_GPIO_NUM;
    c.xclk_freq_hz = 20000000;
    c.ledc_timer = LEDC_TIMER_0;
    c.ledc_channel = LEDC_CHANNEL_0;
    c.pixel_format = PIXFORMAT_GRAYSCALE;  // luma only, as the model expects
    c.frame_size = psramFound() ? FRAMESIZE_VGA : FRAMESIZE_QVGA;
    c.fb_location = psramFound() ? CAMERA_FB_IN_PSRAM : CAMERA_FB_IN_DRAM;
    c.fb_count = 1;
    // On demand: the sensor fills the buffer once after each return and then
    // idles, so no camera DMA competes with inference for the PSRAM/flash cache.
    c.grab_mode = CAMERA_GRAB_WHEN_EMPTY;
    if (esp_camera_init(&c) != ESP_OK) return false;
    apply_orientation();
    return true;
}

static bool capture(bool flash) {
    const int64_t t0 = now_us();
    if (flash) {
        digitalWrite(FLASH_LED, HIGH);
        delay(150);  // let exposure settle under the LED
    }
    // The held buffer was filled when it was last returned; discard it to get a frame taken now.
    if (camera_fb_t *stale = esp_camera_fb_get()) esp_camera_fb_return(stale);
    camera_fb_t *fb = esp_camera_fb_get();
    digitalWrite(FLASH_LED, LOW);
    g_capture_ms = (now_us() - t0) / 1000.0f;
    if (!fb) return false;
    if (!g_frame || int(fb->width * fb->height) != g_fw * g_fh) {
        free(g_frame);
        g_frame = (uint8_t *)ps_malloc(fb->width * fb->height);
    }
    if (g_frame) {
        memcpy(g_frame, fb->buf, fb->width * fb->height);
        g_fw = fb->width;
        g_fh = fb->height;
    }
    esp_camera_fb_return(fb);
    return g_frame != nullptr;
}

// ============================================================================
// Glyph-centred crop
// ============================================================================
/**
 * Finds the digit inside one wheel cell and returns a crop with the training
 * geometry centred on it, so the result does not depend on how tightly the
 * operator drew the box. The digit is the tallest connected ink component
 * (Otsu threshold, minority polarity) that does not touch the search border
 * and is centred in the cell; nearby fragments (broken strokes) are merged.
 * Returns false when no plausible glyph is found; the caller then uses the cell.
 */
static bool fit_glyph(const Box &cell, int pitch, Box *roi) {
    const int mx = cell.w / 4, my = cell.h / 4;
    const int x0 = max(0, cell.x - mx), y0 = max(0, cell.y - my);
    const int x1 = min(g_fw, cell.x + cell.w + mx), y1 = min(g_fh, cell.y + cell.h + my);
    const int sw = x1 - x0, sh = y1 - y0, n = sw * sh;
    if (n <= 0 || n > SEARCH_MAX_PX || !g_search) return false;
    for (int r = 0; r < sh; ++r) memcpy(g_search + r * sw, g_frame + (y0 + r) * g_fw + x0, sw);

    const int t = amr_otsu(g_search, n);
    int bright = 0;
    for (int i = 0; i < n; ++i) bright += g_search[i] > t;
    const bool ink_bright = bright * 2 < n;
    memset(g_seen, 0, n);

    struct Comp {
        int x0, y0, x1, y1, area;
        bool edge;
    };
    static Comp comps[256];
    int nc = 0;
    for (int start = 0; start < n; ++start) {
        if (g_seen[start] || ((g_search[start] > t) != ink_bright)) continue;
        Comp c = {sw, sh, -1, -1, 0, false};
        int sp = 0;
        g_stack[sp++] = start;
        g_seen[start] = 1;
        while (sp) {
            const int p = g_stack[--sp], px = p % sw, py = p / sw;
            c.area++;
            if (px < c.x0) c.x0 = px;
            if (px > c.x1) c.x1 = px;
            if (py < c.y0) c.y0 = py;
            if (py > c.y1) c.y1 = py;
            if (px == 0 || py == 0 || px == sw - 1 || py == sh - 1) c.edge = true;
            const int nb[4] = {px > 0 ? p - 1 : -1, px < sw - 1 ? p + 1 : -1, py > 0 ? p - sw : -1, py < sh - 1 ? p + sw : -1};
            for (int q : nb)
                if (q >= 0 && !g_seen[q] && ((g_search[q] > t) == ink_bright)) {
                    g_seen[q] = 1;
                    g_stack[sp++] = q;
                }
        }
        if (nc < 256 && c.area >= 4) comps[nc++] = c;
    }

    // Main glyph: tallest plausible component centred in the cell.
    const int cx0 = cell.x - x0, cx1 = cx0 + cell.w;
    int best = -1;
    for (int i = 0; i < nc; ++i) {
        const Comp &c = comps[i];
        const int h = c.y1 - c.y0 + 1, w = c.x1 - c.x0 + 1, mid = (c.x0 + c.x1) / 2;
        const float fill = float(c.area) / (w * h);
        if (c.edge || h < 0.3f * cell.h || h > 1.3f * cell.h || w > 1.2f * cell.w || fill < 0.06f) continue;
        if (mid < cx0 || mid >= cx1) continue;
        if (best < 0 || h > comps[best].y1 - comps[best].y0 + 1) best = i;
    }
    if (best < 0) return false;

    Comp g = comps[best];
    const int gh0 = g.y1 - g.y0 + 1, min_area = max(4, cell.w * cell.h / 200);
    for (int i = 0; i < nc; ++i) {
        const Comp &c = comps[i];
        if (i == best || c.edge || c.area < min_area) continue;
        const int ov = min(c.x1, g.x1) - max(c.x0, g.x0) + 1;
        if (ov * 2 < c.x1 - c.x0 + 1) continue;
        if (c.y0 < g.y0 - gh0 * 3 / 10 || c.y1 > g.y1 + gh0 * 3 / 10) continue;
        g.x0 = min(g.x0, c.x0);
        g.y0 = min(g.y0, c.y0);
        g.x1 = max(g.x1, c.x1);
        g.y1 = max(g.y1, c.y1);
    }

    const float gh = g.y1 - g.y0 + 1, gcx = x0 + (g.x0 + g.x1 + 1) / 2.0f, gcy = y0 + (g.y0 + g.y1 + 1) / 2.0f;
    const int rh = int(lroundf(ROI_HEIGHT_PER_GLYPH * gh));
    const int rw = int(lroundf(fminf(ROI_ASPECT * rh, 1.04f * pitch)));
    if (rh > g_fh || rw > g_fw || rh > MAX_CROP_H || rw > MAX_CROP_W || rw < 4) return false;
    roi->w = rw;
    roi->h = rh;
    roi->x = constrain(int(lroundf(gcx - rw / 2.0f)), 0, g_fw - rw);
    roi->y = constrain(int(lroundf(gcy - rh / 2.0f)), 0, g_fh - rh);
    return true;
}

// ============================================================================
// HTTP
// ============================================================================
static String b64(const uint8_t *data, size_t n) {
    static const char *A = "ABCDEFGHIJKLMNOPQRSTUVWXYZabcdefghijklmnopqrstuvwxyz0123456789+/";
    String s;
    s.reserve((n + 2) / 3 * 4);
    for (size_t i = 0; i < n; i += 3) {
        const uint32_t v = (data[i] << 16) | ((i + 1 < n ? data[i + 1] : 0) << 8) | (i + 2 < n ? data[i + 2] : 0);
        s += A[(v >> 18) & 63];
        s += A[(v >> 12) & 63];
        s += i + 1 < n ? A[(v >> 6) & 63] : '=';
        s += i + 2 < n ? A[v & 63] : '=';
    }
    return s;
}

static void send_json_error(int code, const char *msg) {
    server.send(code, "application/json", String("{\"error\":\"") + msg + "\"}");
}

static void handle_selftest() {
    if (server.hasArg("run")) run_selftest();
    const SelfTest &t = g_test;
    char buf[560];
    snprintf(buf, sizeof buf,
             "{\"cpu_mhz\":%u,\"macs\":%u,\"golden_n\":%d,\"exact\":%d,\"mismatched_bytes\":%d,\"label_hits\":%d,"
             "\"pre_n\":%d,\"pre_exact\":%d,\"pre_max_diff\":%d,\"infer_us\":%.1f,\"pre_us\":%.1f,"
             "\"psram\":%s,\"free_heap\":%u,\"free_psram\":%u,\"frame\":[%d,%d],\"hmirror\":%d,\"vflip\":%d}",
             getCpuFrequencyMhz(), amr_macs(), GOLDEN_N, t.exact, t.mismatched_bytes, t.label_hits, PRE_N, t.pre_exact,
             t.pre_max_diff, t.infer_us, t.pre_us, psramFound() ? "true" : "false", ESP.getFreeHeap(), ESP.getFreePsram(),
             g_fw, g_fh, g_hmirror, g_vflip);
    server.send(200, "application/json", buf);
}

static void handle_config() {
    if (server.hasArg("hmirror")) g_hmirror = server.arg("hmirror") == "1";
    if (server.hasArg("vflip")) g_vflip = server.arg("vflip") == "1";
    apply_orientation();
    prefs.putBool("hmirror", g_hmirror);
    prefs.putBool("vflip", g_vflip);
    server.send(200, "application/json", String("{\"hmirror\":") + g_hmirror + ",\"vflip\":" + g_vflip + "}");
}

static void handle_capture() {
    if (!capture(server.arg("flash") == "1")) return send_json_error(500, "capture failed");
    uint8_t *jpg = nullptr;
    size_t len = 0;
    if (!fmt2jpg(g_frame, g_fw * g_fh, g_fw, g_fh, PIXFORMAT_GRAYSCALE, 85, &jpg, &len))
        return send_json_error(500, "jpeg encode failed");
    server.sendHeader("Cache-Control", "no-store");
    server.setContentLength(len);
    server.send(200, "image/jpeg", "");
    server.sendContent((const char *)jpg, len);
    free(jpg);
}

static void handle_read() {
    if (!g_frame || !g_crop) return send_json_error(409, "capture a frame first");
    const int x = server.arg("x").toInt(), y = server.arg("y").toInt();
    const int w = server.arg("w").toInt(), h = server.arg("h").toInt();
    const int n = server.arg("n").toInt();
    const bool fit = server.arg("fit") != "0";
    if (n < 1 || n > 10) return send_json_error(400, "wheel count must be 1-10");
    if (x < 0 || y < 0 || w < n * 4 || h < 8 || x + w > g_fw || y + h > g_fh) return send_json_error(400, "box outside frame");

    String wheels = "[", reading;
    int8_t input[DIGIT_IN_W * DIGIT_IN_H], logits[DIGIT_NUM_CLASSES];
    uint8_t view[DIGIT_IN_W * DIGIT_IN_H];
    int64_t fit_us = 0, pre_us = 0, infer_us = 0;
    float min_p = 1;
    const float cw = float(w) / n;
    for (int i = 0; i < n; ++i) {
        const int cx0 = x + int(lroundf(i * cw)), cx1 = x + int(lroundf((i + 1) * cw));
        const Box cell = {cx0, y, cx1 - cx0, h};
        Box roi = cell;
        int64_t t0 = now_us();
        const bool fitted = fit && fit_glyph(cell, int(lroundf(cw)), &roi);
        int64_t t1 = now_us();
        if (roi.h > MAX_CROP_H || roi.w > MAX_CROP_W) return send_json_error(400, "wheel crop too large: move the camera back");
        for (int r = 0; r < roi.h; ++r) memcpy(g_crop + r * roi.w, g_frame + (roi.y + r) * g_fw + roi.x, roi.w);
        amr_normalize(g_crop, roi.w, roi.h, input);
        int64_t t2 = now_us();
        amr_invoke(input, logits);
        int64_t t3 = now_us();
        fit_us += t1 - t0;
        pre_us += t2 - t1;
        infer_us += t3 - t2;
        const DigitResult d = amr_decode(logits);
        if (d.confidence < min_p) min_p = d.confidence;
        reading += d.cls == DIGIT_REJECT_CLASS ? '?' : class_char(d.cls);
        for (int k = 0; k < DIGIT_IN_W * DIGIT_IN_H; ++k) view[k] = uint8_t(input[k] - DIGIT_IN_ZERO_POINT);
        char head[200];
        snprintf(head, sizeof head,
                 "%s{\"digit\":\"%c\",\"p\":%.4f,\"alt\":\"%c\",\"p_alt\":%.4f,\"box\":[%d,%d,%d,%d],\"fitted\":%s,\"input\":\"",
                 i ? "," : "", class_char(d.cls), d.confidence, class_char(d.runner_up), d.runner_up_confidence, roi.x, roi.y,
                 roi.w, roi.h, fitted ? "true" : "false");
        wheels += head;
        wheels += b64(view, sizeof view);
        wheels += "\"}";
    }
    wheels += "]";
    char tail[300];
    snprintf(tail, sizeof tail,
             ",\"reading\":\"%s\",\"min_p\":%.4f,\"capture_ms\":%.1f,\"fit_us\":%lld,\"preprocess_us\":%lld,\"inference_us\":%lld,"
             "\"macs\":%u}",
             reading.c_str(), min_p, g_capture_ms, fit_us, pre_us, infer_us, amr_macs() * n);
    server.send(200, "application/json", String("{\"wheels\":") + wheels + tail);
    Serial.printf("read %s  min p %.3f  fit %lld us  preprocess %lld us  inference %lld us (%d wheels)\n", reading.c_str(),
                  min_p, fit_us, pre_us, infer_us, n);
}

static const char PAGE[] PROGMEM = R"HTML(<!DOCTYPE html>
<html lang="en"><head><meta charset="utf-8"><meta name="viewport" content="width=device-width,initial-scale=1">
<title>AMR-Edge ESP32-CAM</title>
<style>
body{margin:0;font:13px/1.45 'Segoe UI',system-ui,sans-serif;color:#1f2328;background:#eceef1}
header{padding:8px 16px;background:#fff;border-bottom:1px solid #d9dce1;font-weight:600}
main{max-width:1100px;margin:0 auto;padding:12px 16px;display:grid;gap:12px}
.panel{background:#fff;border:1px solid #d9dce1;border-radius:3px}
.head{padding:6px 10px;background:#f3f4f6;border-bottom:1px solid #d9dce1;font-weight:600;display:flex;gap:8px;align-items:center;flex-wrap:wrap}
.head .tools{margin-left:auto;display:flex;gap:8px;align-items:center;font-weight:400;flex-wrap:wrap}
.sep{width:1px;height:18px;background:#b9bec7}
.body{padding:10px 12px}
table{border-collapse:collapse;width:100%;font-size:12px}
td,th{border:1px solid #d9dce1;padding:3px 8px;text-align:left}th{background:#f6f7f9}
.mono{font-family:Consolas,monospace}
button{height:26px;padding:0 12px;border:1px solid #b9bec7;border-radius:3px;background:#fdfdfd;font:inherit}
button.primary{background:#0a5fb4;border-color:#0a5fb4;color:#fff}
input[type=number]{width:52px;height:24px}
.view{position:relative;display:inline-block;max-width:100%}
.view img,.view canvas{display:block;max-width:100%}
.view canvas{position:absolute;inset:0;width:100%;height:100%;cursor:crosshair;touch-action:none}
.reading{font:600 28px Consolas,monospace;letter-spacing:4px}
.pass{color:#1a7f37;font-weight:600}.fail{color:#c62828;font-weight:600}.warn{color:#9a6700}
tr.low td{background:#fff8e6}
#status{color:#4b5260;margin-top:6px}
.wheel canvas{width:24px;height:32px;image-rendering:pixelated;border:1px solid #d9dce1;display:block}
</style></head><body>
<header>AMR-Edge &middot; ESP32-CAM model test</header>
<main>
<section class="panel"><div class="head">Self-test<div class="tools"><button id="rerun">Run again</button></div></div>
<div class="body"><table id="st"></table></div></section>
<section class="panel"><div class="head">Camera frame
<div class="tools"><label><input type="checkbox" id="hmirror"> Mirror</label><label><input type="checkbox" id="vflip"> Flip</label>
<span class="sep"></span><label><input type="checkbox" id="flash"> Flash</label><button id="cap">Capture</button>
<span class="sep"></span>Wheels <input type="number" id="n" min="1" max="10" value="5">
<label><input type="checkbox" id="fit" checked> Fit to digit</label><button class="primary" id="read">Read</button></div></div>
<div class="body"><div class="view"><img id="img" alt="Camera frame"><canvas id="ov"></canvas></div>
<div id="status">Drag a box around the digit window.</div></div></section>
<section class="panel"><div class="head">Result</div><div class="body">
<div class="reading" id="reading">&mdash;</div><table id="res"></table><br><table id="wh"></table></div></section>
</main>
<script>
const $=id=>document.getElementById(id);let box=null,drag=null,last=null;
try{box=JSON.parse(localStorage.getItem('amrBox'))}catch(e){}
try{const n=localStorage.getItem('amrN');if(n)$('n').value=n}catch(e){}
function rows(t,r){t.innerHTML=r.map(([k,v])=>`<tr><th>${k}</th><td class="mono">${v}</td></tr>`).join('')}
async function selftest(run){const s=await (await fetch('/selftest'+(run?'?run=1':''))).json();
const ok=s.exact===s.golden_n&&s.pre_exact===s.pre_n;$('hmirror').checked=!!s.hmirror;$('vflip').checked=!!s.vflip;
rows($('st'),[['Result',`<span class="${ok?'pass':'fail'}">${ok?'PASS':'FAIL'}</span>`],
['Kernels vs TFLite',`${s.exact}/${s.golden_n} vectors bit-exact`],['Top-1 vs label',`${s.label_hits}/${s.golden_n}`],
['Preprocessing vs Python',`${s.pre_exact}/${s.pre_n} identical (max diff ${s.pre_max_diff})`],
['Inference per wheel',`${(s.infer_us/1000).toFixed(2)} ms (${s.macs.toLocaleString()} MACs)`],
['Preprocessing per wheel',`${(s.pre_us/1000).toFixed(2)} ms`],['Throughput',`${(s.macs/s.infer_us).toFixed(1)} MMAC/s at ${s.cpu_mhz} MHz`],
['Memory free',`heap ${(s.free_heap/1024).toFixed(0)} KB, PSRAM ${(s.free_psram/1024).toFixed(0)} KB`]])}
function draw(){const c=$('ov'),g=c.getContext('2d');g.clearRect(0,0,c.width,c.height);const b=drag||box;if(!b)return;
g.lineWidth=2;g.strokeStyle='#1f6fd1';g.strokeRect(b.x,b.y,b.w,b.h);const n=+$('n').value||1;g.setLineDash([4,3]);
for(let i=1;i<n;i++){const x=b.x+i*b.w/n;g.beginPath();g.moveTo(x,b.y);g.lineTo(x,b.y+b.h);g.stroke()}g.setLineDash([]);
if(last&&!drag)last.wheels.forEach(w=>{const[x,y,bw,bh]=w.box;g.strokeStyle=w.fitted?'#1a7f37':'#9a6700';g.lineWidth=1.5;g.strokeRect(x+.5,y+.5,bw,bh)})}
function capture(){last=null;$('status').textContent='Capturing...';$('img').src='/capture.jpg?flash='+($('flash').checked?1:0)+'&t='+Date.now()}
$('img').onload=()=>{const c=$('ov');c.width=$('img').naturalWidth;c.height=$('img').naturalHeight;draw();
$('status').textContent=`Frame ${c.width}x${c.height}. Drag a box around the digit window.`};
async function orient(){await fetch(`/config?hmirror=${$('hmirror').checked?1:0}&vflip=${$('vflip').checked?1:0}`);box=null;
try{localStorage.removeItem('amrBox')}catch(e){}capture()}
$('hmirror').onchange=orient;$('vflip').onchange=orient;
const pt=e=>{const r=$('ov').getBoundingClientRect();return{x:(e.clientX-r.left)*$('ov').width/r.width,y:(e.clientY-r.top)*$('ov').height/r.height}};
$('ov').onpointerdown=e=>{const p=pt(e);drag={x0:p.x,y0:p.y,x:p.x,y:p.y,w:0,h:0};$('ov').setPointerCapture(e.pointerId)};
$('ov').onpointermove=e=>{if(!drag)return;const p=pt(e);Object.assign(drag,{x:Math.min(drag.x0,p.x),y:Math.min(drag.y0,p.y),w:Math.abs(p.x-drag.x0),h:Math.abs(p.y-drag.y0)});draw()};
$('ov').onpointerup=()=>{if(drag&&drag.w>8&&drag.h>8){box={x:Math.round(drag.x),y:Math.round(drag.y),w:Math.round(drag.w),h:Math.round(drag.h)};last=null;
try{localStorage.setItem('amrBox',JSON.stringify(box))}catch(e){}}drag=null;draw()};
$('n').onchange=()=>{try{localStorage.setItem('amrN',$('n').value)}catch(e){}draw()};
async function read(){if(!box){$('status').textContent='Draw a box first.';return}
const q=new URLSearchParams({...box,n:$('n').value,fit:$('fit').checked?1:0});const r=await (await fetch('/read?'+q)).json();
if(r.error){$('status').textContent='Error: '+r.error;return}
last=r;draw();$('reading').textContent=r.reading;const nf=r.wheels.filter(w=>!w.fitted).length;
rows($('res'),[['Lowest confidence',`<span class="${r.min_p<0.5?'warn':''}">${r.min_p.toFixed(3)}${r.min_p<0.5?' (review)':''}</span>`],
['Capture',`${r.capture_ms.toFixed(1)} ms`],['Digit fitting (all wheels)',`${(r.fit_us/1000).toFixed(2)} ms`],
['Preprocessing (all wheels)',`${(r.preprocess_us/1000).toFixed(2)} ms`],['Inference (all wheels)',`${(r.inference_us/1000).toFixed(2)} ms`],
['Compute',`${r.macs.toLocaleString()} MACs`]]);
$('wh').innerHTML='<tr><th>#</th><th>Crop</th><th>Model input</th><th>Digit</th><th>p</th><th>Runner-up</th></tr>'+r.wheels.map((w,i)=>
`<tr class="wheel${w.p<0.5?' low':''}"><td>${i+1}</td><td class="mono">${w.fitted?'fitted':'cell'}</td><td><canvas data-i="${i}" width="24" height="32"></canvas></td><td class="mono">${w.digit}</td><td class="mono">${w.p.toFixed(3)}</td><td class="mono">${w.alt} (${w.p_alt.toFixed(3)})</td></tr>`).join('');
r.wheels.forEach((w,i)=>{const b=atob(w.input),c=document.querySelector(`canvas[data-i="${i}"]`),g=c.getContext('2d'),im=g.createImageData(24,32);
for(let k=0;k<768;k++){const v=b.charCodeAt(k);im.data.set([v,v,v,255],k*4)}g.putImageData(im,0,0)});
$('status').textContent=nf?`Read on device. ${nf} wheel(s) used the plain cell (no digit found): amber boxes.`:'Read on device. Green boxes are the crops the model saw.'}
$('cap').onclick=capture;$('read').onclick=read;$('rerun').onclick=()=>selftest(true);
selftest(false);capture();
</script></body></html>)HTML";

// ============================================================================
// Setup / loop
// ============================================================================
static void wifi_start() {
    if (strlen(WIFI_SSID)) {
        WiFi.mode(WIFI_STA);
        WiFi.begin(WIFI_SSID, WIFI_PASS);
        Serial.printf("Joining %s", WIFI_SSID);
        for (int i = 0; i < 30 && WiFi.status() != WL_CONNECTED; ++i) {
            delay(500);
            Serial.print('.');
        }
        Serial.println();
        if (WiFi.status() == WL_CONNECTED) {
            Serial.printf("Open http://%s\n", WiFi.localIP().toString().c_str());
            return;
        }
        Serial.println("Could not join; starting access point instead");
    }
    WiFi.mode(WIFI_AP);
    WiFi.softAP(AP_SSID, AP_PASS);
    Serial.printf("Join Wi-Fi \"%s\" (password %s), then open http://%s\n", AP_SSID, AP_PASS, WiFi.softAPIP().toString().c_str());
}

static void *big_alloc(size_t n) { return psramFound() ? ps_malloc(n) : malloc(n); }

void setup() {
    Serial.begin(115200);
    pinMode(FLASH_LED, OUTPUT);
    digitalWrite(FLASH_LED, LOW);
    delay(300);
    Serial.printf("\nPSRAM: %s\n", psramFound() ? "found" : "NOT found (enable it in Tools > PSRAM)");

    // Engine first, so its buffers and weights get internal SRAM before Wi-Fi does.
    if (!amr_init()) Serial.println("Model init failed: not enough internal memory");
    run_selftest();

    prefs.begin("amr", false);
    g_hmirror = prefs.getBool("hmirror", false);
    g_vflip = prefs.getBool("vflip", false);

    g_crop = (uint8_t *)big_alloc(MAX_CROP_W * MAX_CROP_H);
    g_search = (uint8_t *)big_alloc(SEARCH_MAX_PX);
    g_seen = (uint8_t *)big_alloc(SEARCH_MAX_PX);
    g_stack = (int32_t *)big_alloc(SEARCH_MAX_PX * sizeof(int32_t));
    if (!g_search || !g_seen || !g_stack) {
        Serial.println("Glyph search buffers unavailable; reads will use plain cells");
        g_search = nullptr;
    }
    if (!camera_init()) Serial.println("Camera init failed: check the ribbon cable and power supply");

    wifi_start();
    server.on("/", [] { server.send_P(200, "text/html", PAGE); });
    server.on("/selftest", handle_selftest);
    server.on("/config", handle_config);
    server.on("/capture.jpg", handle_capture);
    server.on("/read", handle_read);
    server.begin();
}

void loop() { server.handleClient(); }
